## boards/shields/riboard/Kconfig.defconfig
```kconfig
# Copyright (c) 2022 The ZMK Contributors
# SPDX-License-Identifier: MIT

if SHIELD_SWWEEEP_LEFT

config ZMK_KEYBOARD_NAME
    default "riboard"

config ZMK_SPLIT_ROLE_CENTRAL
    default y

endif

if SHIELD_RIBOARD_LEFT || SHIELD_RIBOARD_RIGHT
config ZMK_SPLIT
    default y
endif
```
